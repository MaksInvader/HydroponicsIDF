## sdkconfig.defaults
```kconfig
CONFIG_ESP_REV_MIN_FULL=0
CONFIG_ESP32S3_REV_MIN_FULL=0
CONFIG_ESP_EFUSE_BLOCK_REV_MIN_FULL=0
CONFIG_BOOTLOADER_APP_ROLLBACK_ENABLE=n
CONFIG_BOOTLOADER_APP_ANTI_ROLLBACK=n
CONFIG_BOOTLOADER_APP_SECURE_VERSION=0
CONFIG_ESPTOOLPY_FLASHMODE_DIO=y
CONFIG_ESPTOOLPY_FLASHFREQ_80M=y
CONFIG_ESP32S3_DATA_CACHE_LINE_32B=y
CONFIG_ESP32S3_INSTRUCTION_CACHE_LINE_32B=y
CONFIG_LWIP_MAX_SOCKETS=16
CONFIG_VFS_MAX_COUNT=16
CONFIG_ESP_DEBUG_OCDAWARE=n
CONFIG_ESPTOOLPY_FLASHSIZE_16MB=y
CONFIG_ESPTOOLPY_FLASHSIZE="16MB"
CONFIG_PARTITION_TABLE_CUSTOM=y
CONFIG_PARTITION_TABLE_CUSTOM_FILENAME="partitions.csv"
CONFIG_ESP_CONSOLE_SECONDARY_NONE=y
```
